## boards/eyelashperipherals/eyelash_sofle/Kconfig.defconfig
```kconfig
#
# Copyright (c) 2024 The ZMK Contributors
# SPDX-License-Identifier: MIT
#

if BOARD_EYELASH_SOFLE_LEFT

config ZMK_KEYBOARD_NAME
    default "Eyelash Sofle"

config ZMK_SPLIT_ROLE_CENTRAL
    default y

endif # BOARD_EYELASH_SOFLE_LEFT


if BOARD_EYELASH_SOFLE_LEFT || BOARD_EYELASH_SOFLE_RIGHT

config BOARD
    default "eyelash_sofle"

config BOARD_ENABLE_DCDC
    bool "Enable DCDC mode"
    select SOC_DCDC_NRF52X
    default y

config BOARD_ENABLE_DCDC_HV
    bool "Enable High Voltage DCDC converter"
    select SOC_DCDC_NRF52X_HV
    default y

config ZMK_SPLIT
    default y

config BT_CTLR
    default BT

if USB

config USB_NRFX
    default y

config USB_DEVICE_STACK
    default y

endif # USB

if ZMK_DISPLAY

choice ZMK_DISPLAY_WORK_QUEUE
    default ZMK_DISPLAY_WORK_QUEUE_DEDICATED
endchoice

endif # ZMK_DISPLAY

if ZMK_BACKLIGHT

config PWM
    default y

config LED_PWM
    default y

endif # ZMK_BACKLIGHT

endif # BOARD_EYELASH_SOFLE_LEFT || BOARD_EYELASH_SOFLE_RIGHT
```

## boards/shields/eyelash_sofle_dongle/Kconfig.defconfig
```kconfig
if SHIELD_EYELASH_SOFLE_DONGLE

config ZMK_KEYBOARD_NAME
    default "Eyelash Sofle"

config ZMK_SPLIT_ROLE_CENTRAL
    default y

config ZMK_SPLIT
    default y

config ZMK_POINTING
    default y

# Eyelash Sofle has 2 peripherals (left and right)
config ZMK_SPLIT_BLE_CENTRAL_PERIPHERALS
    default 2

# Set to peripherals (2) + BT profiles (5) = 7
config BT_MAX_CONN
    default 7

config BT_MAX_PAIRED
    default 7

endif
```

## boards/shields/eyelash_sofle_dongle/Kconfig.shield
```kconfig
config SHIELD_EYELASH_SOFLE_DONGLE
    def_bool $(shields_list_contains,eyelash_sofle_dongle)
    select SHIELD_PROSPECTOR_ADAPTER
```

## config/west.yml
```yaml
manifest:
  remotes:
    - name: zmkfirmware
      url-base: https://github.com/zmkfirmware
    - name: m165437
      url-base: https://github.com/M165437
    - name: carrefinho
      url-base: https://github.com/carrefinho
  projects:
    - name: eyelash_sofle
      url: https://github.com/mateusfdl/zmk-sofle-v2
      revision: main
    - name: zmk
      remote: zmkfirmware
      revision: v0.3.0
      import: app/west.yml
    - name: nice-view-gem
      remote: m165437
      revision: main
    - name: prospector-zmk-module
      remote: carrefinho
      revision: main
  self:
    path: boards
```
